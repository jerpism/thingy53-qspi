## CMakeLists.txt
```
# SPDX-License-Identifier: Apache-2.0

cmake_minimum_required(VERSION 3.20.0)

find_package(Zephyr REQUIRED HINTS $ENV{ZEPHYR_BASE})
project(thingy53_qspi)

FILE(GLOB app_sources src/*.c src/*.s)
target_sources(app PRIVATE ${app_sources})
```

## prj.conf
```kconfig
CONFIG_NORDIC_QSPI_NOR=y
CONFIG_FLASH=y
CONFIG_NRFX_QSPI=y
CONFIG_XIP=y
CONFIG_NORDIC_QSPI_NOR_XIP=y
```

## src/main.c
```c
#include <stdio.h>
#include <zephyr/kernel.h>
#include <zephyr/drivers/flash.h>
#include <stdint.h>

#include "qspi.h"

int main(void){	
    uint32_t read_data = 0;
    qspi_read(&read_data, sizeof(read_data), 0x0);

    /* Sleep is required for printk() to read correct data */
    k_msleep(100);
    printk("Value of read_data: %x\n", read_data);

    return 0;
}
```
